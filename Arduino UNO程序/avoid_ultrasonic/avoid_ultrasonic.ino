//=======================================================
//  智能小车 编写 dengqilong 2019.09.07 QQ1303428517
//========================================================

int Echo = A1;  // Echo回声脚
int Trig =A0;  //  Trig 触发脚

int LED1 = 12; // LED,板子上丝印为DS3
int LED2 =7;   // LED,板子上丝印为DS4

int LED1_BLINK_FREQUENCY = 500;
int LED2_BLINK_FREQUENCY = 500;
unsigned long lastTimer_LED1 = 0;
unsigned long lastTimer_LED2 = 0;
bool led1_value=LOW;
bool led2_value=LOW;

int Distance = 0;

int old_state=0;
int new_state=0;
int state=0;
bool changed=false;

int Left_motor_go=8;     //左电机前进(IN1)
int Left_motor_back=9;     //左电机后退(IN2)

int Right_motor_go=10;    // 右电机前进(IN3)
int Right_motor_back=11;    // 右电机后退(IN4)

int key=A2;//定义按键 A2 接口
int beep=A3;//定义蜂鸣器 A3 接口

//使用了A0、A1、A2、A3 空闲A4、A5
//使用了D8、D9、D10、D11 空闲D13、D0、D1、D2、D3、D4、D5、D6


#include <Adafruit_NeoPixel.h>
#ifdef __AVR__
 #include <avr/power.h> // Required for 16 MHz Adafruit Trinket
#endif
#define LED_PIN     2
#define LED_COUNT  256
// NeoPixel brightness, 0 (min) to 255 (max)
#define BRIGHTNESS 1
Adafruit_NeoPixel strip(LED_COUNT, LED_PIN, NEO_GRB + NEO_KHZ800);

#include <avr/pgmspace.h>

//r g b
const unsigned char rgbArray_common[256][3] PROGMEM =
{ 
{0,0,0},
{0,0,0},
{0,0,0},
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{0,0,0},
};
const unsigned char rgbArray_unhappy[256][3]PROGMEM=
{ 
{0,0,0},
{0,0,0},
{0,0,0},
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{0,0,0},
};
const unsigned char rgbArray_happy[256][3] PROGMEM=
{ 
{0,0,0},
{0,0,0},
{0,0,0},
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{0,0,0},
};
const unsigned char rgbArray_uncomfortable[256][3] PROGMEM=
{ 
{0,0,0},
{0,0,0},
{0,0,0},
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{0,0,0},
};
const unsigned char rgbArray_angry[256][3] PROGMEM=
{ 
{0,0,0},
{0,0,0},
{0,0,0},
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{0,0,0},
};

void setup()
{
  Serial.begin(9600);     // 初始化串口
  
  //初始化电机驱动IO为输出方式
  pinMode(Left_motor_go,OUTPUT); // PIN 8 (PWM)
  pinMode(Left_motor_back,OUTPUT); // PIN 9 (PWM)
  pinMode(Right_motor_go,OUTPUT);// PIN 10 (PWM) 
  pinMode(Right_motor_back,OUTPUT);// PIN 11 (PWM)
  
  pinMode(key,INPUT);//定义按键接口为输入接口
  pinMode(beep,OUTPUT);
  
  //初始化超声波引脚
  pinMode(Echo, INPUT);    // 定义超声波输入脚
  pinMode(Trig, OUTPUT);   // 定义超声波输出脚
  
  pinMode(LED1, OUTPUT);   // 定义LED1输出脚
  pinMode(LED2, OUTPUT);   // 定义LED2输出脚

#if defined(__AVR_ATtiny85__) && (F_CPU == 16000000)
  clock_prescale_set(clock_div_1);
#endif

  strip.begin();           // INITIALIZE NeoPixel strip object (REQUIRED)
  strip.show();            // Turn OFF all pixels ASAP
  strip.setBrightness(50); // Set BRIGHTNESS to about 1/5 (max = 255)
}

void run(int time)     // 前进
{
  digitalWrite(Right_motor_go,LOW);  //右轮后退
  digitalWrite(Right_motor_back,HIGH);
  analogWrite(Right_motor_go,0);
  analogWrite(Right_motor_back,150);//PWM比例0~255调速
  digitalWrite(Left_motor_go,HIGH);  //左轮后退
  digitalWrite(Left_motor_back,LOW);
  analogWrite(Left_motor_go,150);
  analogWrite(Left_motor_back,0);//PWM比例0~255调速
  delay(time * 100);   //执行时间，可以调整  
}

void brake(int time)  //刹车，停车
{
  digitalWrite(Right_motor_go,LOW);
  digitalWrite(Right_motor_back,LOW);
  digitalWrite(Left_motor_go,LOW);
  digitalWrite(Left_motor_back,LOW);
  delay(time * 100);//执行时间，可以调整  
}

void left(int time)         //左转(左轮不动，右轮前进)
{
  digitalWrite(Right_motor_go,HIGH);	// 右电机前进
  digitalWrite(Right_motor_back,LOW);
  analogWrite(Right_motor_go,150); 
  analogWrite(Right_motor_back,0);//PWM比例0~255调速
  digitalWrite(Left_motor_go,LOW);   //左轮后退
  digitalWrite(Left_motor_back,LOW);
  analogWrite(Left_motor_go,0); 
  analogWrite(Left_motor_back,0);//PWM比例0~255调速
  delay(time * 100);	//执行时间，可以调整  
}

void spin_left(int time)//左转(左轮后退，右轮前进)
{
  digitalWrite(Right_motor_go,HIGH);	// 右电机前进
  digitalWrite(Right_motor_back,LOW);
  analogWrite(Right_motor_go,150); 
  analogWrite(Right_motor_back,0);//PWM比例0~255调速
  digitalWrite(Left_motor_go,HIGH);   //左轮后退
  digitalWrite(Left_motor_back,LOW);
  analogWrite(Left_motor_go,150); 
  analogWrite(Left_motor_back,0);//PWM比例0~255调速
  delay(time * 100);	//执行时间，可以调整  
}

void right(int time)//右转(右轮不动，左轮前进)
{
  digitalWrite(Right_motor_go,LOW);   //右电机后退
  digitalWrite(Right_motor_back,LOW);
  analogWrite(Right_motor_go,0); 
  analogWrite(Right_motor_back,0);//PWM比例0~255调速
  digitalWrite(Left_motor_go,LOW);//左电机前进
  digitalWrite(Left_motor_back,HIGH);
  analogWrite(Left_motor_go,0); 
  analogWrite(Left_motor_back,150);//PWM比例0~255调速
  delay(time * 100);	//执行时间，可以调整  
}

void spin_right(int time)//右转(右轮后退，左轮前进)
{
  digitalWrite(Right_motor_go,LOW);   //右电机后退
  digitalWrite(Right_motor_back,HIGH);
  analogWrite(Right_motor_go,0); 
  analogWrite(Right_motor_back,150);//PWM比例0~255调速
  digitalWrite(Left_motor_go,LOW);//左电机前进
  digitalWrite(Left_motor_back,HIGH);
  analogWrite(Left_motor_go,0); 
  analogWrite(Left_motor_back,150);//PWM比例0~255调速
  delay(time * 100);	//执行时间，可以调整        
}

void back(int time) //后退
{
  
  digitalWrite(Right_motor_go,HIGH);  // 右电机前进
  digitalWrite(Right_motor_back,LOW);     
  analogWrite(Right_motor_go,150);//0~255调速，左右轮差异略增减
  analogWrite(Right_motor_back,0);
  digitalWrite(Left_motor_go,LOW);  // 左电机前进
  digitalWrite(Left_motor_back,HIGH);
  analogWrite(Left_motor_go,0);//PWM比例0~255调速，左右轮差异略增减
  analogWrite(Left_motor_back,150);
  delay(time * 100);     //执行时间，可以调整   
}
//==========================================================

void keysacn()//按键扫描
{
  int val;
  val=digitalRead(key);//读取数字口电平值赋给val
  while(!digitalRead(key))//当按键没被按下时，一直循环
  {
    val=digitalRead(key);//此句可省略，可让循环跑空
  }
  while(digitalRead(key))//当按键被按下时
  {
    delay(10);	//延时10ms
    val=digitalRead(key);//读取数字口电平值赋给val
    if(val==HIGH)  //第二次判断按键是否被按下
    {
      digitalWrite(beep,HIGH);		//蜂鸣器响
      while(!digitalRead(key))	//判断按键是否被松开
      digitalWrite(beep,LOW);		//蜂鸣器停止
    }
    else
      digitalWrite(beep,LOW);          //蜂鸣器停止
  }
}

void Distance_test()   // 量出前方距离,2cm~450cm 
{
  digitalWrite(Trig, LOW);   // 给触发脚低电平2μs
  delayMicroseconds(2);
  digitalWrite(Trig, HIGH);  // 给触发脚高电平10μs，这里至少是10μs
  delayMicroseconds(10);
  digitalWrite(Trig, LOW);    // 持续给触发脚低电
  float Fdistance = pulseIn(Echo, HIGH);  // 读取高电平时间(单位：微秒)
  Fdistance= Fdistance/58;       //为什么除以58等于厘米，  Y米=（X秒*344）/2
  // X秒=（ 2*Y米）/344 ==》X秒=0.0058*Y米 ==》厘米=微秒/58
  
  Distance = int(Fdistance);
  Serial.print("Distance:");      //输出距离（单位：厘米）
  Serial.println(Distance);         //显示距离
  
  if(Distance<4)
  {
    Distance=4;
  }
  if(Distance>400)
  {
    Distance=400;
  }
}  

void loop()
{
  keysacn();	   //调用按键扫描函数
  while(1)
  {
    if((millis()-lastTimer_LED1 ) > LED1_BLINK_FREQUENCY)       
    {
        led1_value=!led1_value;
        digitalWrite(LED1, led1_value);  
        lastTimer_LED1 = millis();
    }
    if((millis()-lastTimer_LED2 ) > LED2_BLINK_FREQUENCY)       
    {
        led2_value=!led2_value;
        digitalWrite(LED2, led2_value);
        lastTimer_LED2 = millis();
    }

    old_state=state;

    Distance_test();//测量前方距离
    
    if(Distance > 45)//数值为碰到障碍物的距离，可以按实际情况设置
    {
      state=1;
    }
    else if(Distance <= 22 && (Distance >= 45))
    {
      state=2;
    }

    else if(Distance < 22 && (Distance > 15))
    {
      state=3;
    }
    else if(Distance <= 15 && (Distance >= 7))
    {
      state=4;
    }
    else if(Distance <7)
    {
      state=5;  
    }
    new_state=state;
    
    if(new_state!=old_state)
    {
      changed=true;
    }
    if(changed==true)
    {
      if(state==1)
      {
        LED1_BLINK_FREQUENCY=1000;
        LED2_BLINK_FREQUENCY=1000;
        Serial.print("common\n");
        ws2812_show(5,rgbArray_common);
      }
      else if(state==2)
      {
        LED1_BLINK_FREQUENCY=750;
        LED2_BLINK_FREQUENCY=750;
        Serial.print("happy\n");
        ws2812_show(5,rgbArray_happy);
      }
      else if(state==3)
      {
        LED1_BLINK_FREQUENCY=600;
        LED2_BLINK_FREQUENCY=600;
        Serial.print("unhappy\n");
        ws2812_show(5,rgbArray_unhappy);  
      }
      else if(state==4)
      {
        LED1_BLINK_FREQUENCY=500;
        LED2_BLINK_FREQUENCY=500;
        Serial.print("uncomfortable\n");
        ws2812_show(5,rgbArray_uncomfortable);
      }
       else if(state==5)
      {
        LED1_BLINK_FREQUENCY=375;
        LED2_BLINK_FREQUENCY=375;
        Serial.print("angry\n");
        ws2812_show(5,rgbArray_angry);
        
        back(8);//调整此时间后退到合适的距离
        brake(2); 
        Distance_test();//测量前方距离
        while(Distance<45)  
        {
          back(2);//调整此时间后退到合适的距离
          brake(2); 
          Distance_test();//测量前方距离
        }
      }
      changed=false;
    }
  }
}

void ws2812_show(int brightness,unsigned char rgbArray[][3])
{
  strip.setBrightness(brightness);
  for(int i=0; i<strip.numPixels(); i++)
  { 
    strip.setPixelColor(i, pgm_read_byte(&rgbArray[i][0]),pgm_read_byte(&rgbArray[i][1]),pgm_read_byte(&rgbArray[i][2]));
    strip.show();       
  }                            
}
